## kernel/drivers/analogy/sensoray/Kconfig
```kconfig
config XENO_DRIVERS_ANALOGY_S526
	depends on XENO_DRIVERS_ANALOGY
	tristate "Sensoray Model 526 driver"
	default n

config XENO_DRIVERS_ANALOGY_S626
	depends on XENO_DRIVERS_ANALOGY
	tristate "Sensoray Model 626 driver"
	default n
```
